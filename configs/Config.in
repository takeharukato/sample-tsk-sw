## configs/Config.in
```kconfig
#
# For a description of the syntax of this configuration file,
# see extra/config/Kconfig-language.txt
#

mainmenu "Kernel Configuration"

config CONFIG_HAL
	bool "Hardware Abstraction Layer(HAL)"
	default n
	help
	  If you wish to build the kernel for real hardware, then answer Y here.

config CONFIG_HEAP_SIZE
	int "heap memory size(UNIT:MB)"
	default 64
	range 1 768
	help
	  This sets the value of kernel heap memory size

config CONFIG_TSTACK_PAGE_NR
	int "Task stack pages(UNIT:pages)"
	default 1
	range 1 4
	help
	  This sets the value of default task stack size

config CONFIG_ISTACK_PAGE_NR
	int "Interrupt stack pages(UNIT:pages)"
	default 1
	range 1 4
	help
	  This sets the value of interrupt stack size

choice
    prompt "Timer Interval"
    default CONFIG_TIMER_INTERVAL_MS_10MS
    depends on CONFIG_HAL

config CONFIG_TIMER_INTERVAL_MS_1MS
    bool "1 milliseconds"
    help
      This sets timer tick as 1 milliseconds.

config CONFIG_TIMER_INTERVAL_MS_10MS
    bool "10 milliseconds"
    help
      This sets timer tick as 10 milliseconds.

config CONFIG_TIMER_INTERVAL_MS_100MS
    bool "100 milliseconds"
    help
      This sets timer tick as 100 milliseconds.

endchoice

config CONFIG_UPPERHALF_KERNEL
    bool "Use Upper Half Kernel"
    default n
    help
      Kernel virtual memory is placed onto upper half of virtual memory space.

config CONFIG_TIMER_INTERVAL_MS
       int 
       default 1 if CONFIG_TIMER_INTERVAL_MS_1MS
       depends on CONFIG_HAL

config CONFIG_TIMER_INTERVAL_MS
       int
       default 10 if CONFIG_TIMER_INTERVAL_MS_10MS
       depends on CONFIG_HAL

config CONFIG_TIMER_INTERVAL_MS
       int 
       default 100 if CONFIG_TIMER_INTERVAL_MS_100MS
       depends on CONFIG_HAL

config CONFIG_TIMER_TIME_SLICE
       int "Timer slice of threads (UNIT: ticks)"
       default 10
       help
	  This sets the value of the timer slice for each thread in the round robin scheduling class by tick counts.

source "configs/hal/Config.in"
```

## configs/aarch64/Config.in
```kconfig
config CONFIG_HAL_CFLAGS
       prompt "CFLAGS for Hardware Abstraction Layer"
       string
       default "-ffreestanding -mgeneral-regs-only -mcpu=cortex-a53+nofp  -fno-pic -static -fno-builtin -fno-strict-aliasing" 
       depends on CONFIG_HAL

config CONFIG_HAL_LDFLAGS
       string
       default "-Wl,-z,max-page-size=0x1000 -Wl,--build-id=none"
       depends on CONFIG_HAL

config CONFIG_HAL_OPT_FLAGS
       prompt "Additional optimize flags for HAL"
       string 
       default ""
       depends on CONFIG_HAL

config CONFIG_HAL_PAGE_SIZE
       int
       default 4096

config CONFIG_HAL_PAGE_SHIFT
       int
       default 12

config CONFIG_HAL_STRAIGHT_PAGE_SIZE
       int
       default 2097152

config CONFIG_HAL_KERN_VMA_BASE
       int
       default 0xffffffff00000000 if CONFIG_UPPERHALF_KERNEL
       default 0x0000000000000000 if !CONFIG_UPPERHALF_KERNEL


config CONFIG_HAL_MEMORY_SIZE_MB
       prompt "Max memory size(UNIT:MB)"
       int
       default 128
       range 16 1024
       depends on CONFIG_HAL

choice
       prompt "Console serial port Bits Per Seconds(BPS)"
       default CONFIG_CON_SERIAL_BPS_115200 
       depends on CONFIG_HAL

config CONFIG_CON_SERIAL_BPS_230400
       bool "230400"

config CONFIG_CON_SERIAL_BPS_115200
       bool "115200"

config CONFIG_CON_SERIAL_BPS_76800
       bool "76800"

config CONFIG_CON_SERIAL_BPS_38400
       bool "38400"

config CONFIG_CON_SERIAL_BPS_14400
       bool "14400"

config CONFIG_CON_SERIAL_BPS_2400
       bool "2400"

config CONFIG_CON_SERIAL_BPS_110
       bool "110"

endchoice
```

## configs/x64/Config.in
```kconfig
config CONFIG_HAL_CFLAGS
       prompt "CFLAGS for Hardware Abstraction Layer"
       string
       default "-ffreestanding -m64 -mcmodel=large -mno-red-zone -mno-aes -mno-avx -mno-mmx -mno-sse -msoft-float -fno-asynchronous-unwind-tables -fno-omit-frame-pointer -fno-optimize-sibling-calls" 
       depends on CONFIG_HAL

config CONFIG_HAL_LDFLAGS
       string
       default "-Wl,-z,max-page-size=0x1000 -Wl,--build-id=none"
       depends on CONFIG_HAL

config CONFIG_HAL_OPT_FLAGS
       prompt "Additional optimize flags for HAL"
       string 
       default "-mtune=generic"
       depends on CONFIG_HAL

config CONFIG_HAL_PAGE_SIZE
       int
       default 4096

config CONFIG_HAL_PAGE_SHIFT
       int
       default 12

config CONFIG_HAL_STRAIGHT_PAGE_SIZE
       int
       default 0x200000

config CONFIG_HAL_KERN_VMA_BASE
       int
       default 0xFFFF800000000000 if CONFIG_UPPERHALF_KERNEL
       default 0x0000000000000000 if !CONFIG_UPPERHALF_KERNEL

config CONFIG_HAL_MEMORY_SIZE_MB
       prompt "Max memory size(UNIT:MB)"
       int
       default 128
       range 16 1024
       depends on CONFIG_HAL

choice
       prompt "Console serial port"
       default CONFIG_CON_SERIAL_COM1
       depends on CONFIG_HAL

config CONFIG_CON_SERIAL_COM1
       bool "COM1"

config CONFIG_CON_SERIAL_COM2
       bool "COM2"

config CONFIG_CON_SERIAL_COM3
       bool "COM3"

config CONFIG_CON_SERIAL_COM4
       bool "COM4"
endchoice
```

## configs/x86-64/Config.in
```kconfig
config CONFIG_HAL_CFLAGS
       prompt "CFLAGS for Hardware Abstraction Layer"
       string
       default "-ffreestanding -m64 -mcmodel=large -mno-red-zone -mno-aes -mno-avx -mno-mmx -mno-sse -msoft-float -fno-asynchronous-unwind-tables -fno-omit-frame-pointer -fno-optimize-sibling-calls" 

config CONFIG_HAL_LDFLAGS
       string
       default "-Wl,-z,max-page-size=0x1000 -Wl,--build-id=none"

config CONFIG_HAL_OPT_FLAGS
       prompt "Additional optimize flags for HAL"
       string 
       default "-mtune=generic"

config CONFIG_HAL_PAGE_SIZE
       int
       default 4096
```
