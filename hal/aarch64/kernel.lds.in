OUTPUT_FORMAT("elf64-littleaarch64", "elf64-bigaarch64", "elf64-littleaarch64")
OUTPUT_ARCH(aarch64)
__KERN_VMA_BASE = __KERN_VMA_BASE__;
/* __KERN_VMA_BASE = 0xffffffff00000000; */  /* for Straight map */
__KERN_BASE = 0x40000000;

ENTRY(_start)
SECTIONS
{
	. = __KERN_BASE;
	.boot : {
              *(.boot_text)
	      *(.boot_data)
	}
        . += __KERN_VMA_BASE;
	.text : AT(ADDR(.text) - __KERN_VMA_BASE) { *(.text) }
	.data : AT(ADDR(.data) - __KERN_VMA_BASE) { *(.data) }
	. = ALIGN(__PAGE_SIZE__);
        __bss_start = .;
	.bss :  AT(ADDR(.bss) - __KERN_VMA_BASE) {
 	. = ALIGN(__PAGE_SIZE__ * __TSTACK_PAGES__);
	bsp_stack = .;
	. += (__PAGE_SIZE__ * __TSTACK_PAGES__);
	bsp_stack_end = .;
	*(.bss COMMON) }
	. = ALIGN(__PAGE_SIZE__);
        __bss_end = .;
	_edata = .;			/* End of data section */
	. = ALIGN(__PAGE_SIZE__);
	_payload_start = .;
	.payload : { *(.payload) }
	_payload_end = .;
	. = ALIGN(__PAGE_SIZE__);
	_end = . ;
	_kend = .;
	_kheap_start = .;
	. += (__KHEAP_SIZE__);
	_kheap_end = .;
}

