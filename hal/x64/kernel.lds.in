/* ld script to make 32bit boot loader
 * This is derived from Martin Mares's ld script for i386 Linux kernel.
 * Copyright Takeharu KATO 2000 
 */
OUTPUT_FORMAT("elf64-x86-64", "elf64-x86-64", "elf64-x86-64")
OUTPUT_ARCH(i386:x86-64)
__KERN_VMA_BASE = __KERN_VMA_BASE__;
__KERN_BASE = 0x100000;

ENTRY(start)
SECTIONS
{
    . = __KERN_BASE;
    _kernel_start = .;
    .boot : {
        *(.boot_text)
        *(.boot_data)
    }

    . += __KERN_VMA_BASE;
    .text : AT(ADDR(.text) - __KERN_VMA_BASE) {
        *(.text .rela.text .stub .text.* .gnu.linkonce.t.*)
        _rodata_start = .;
        *(.rodata .rodata.* .gnu.linkonce.r.*)
        _rodata_end = .;
    }

    .data : AT(ADDR(.data) - __KERN_VMA_BASE) {
        _data_start = .;
        *(.data)
        _data_end = .;
    }

    . = ALIGN(__PAGE_SIZE__);
    .bss :  AT(ADDR(.bss) - __KERN_VMA_BASE) {
        __bss_start = .;

	. = ALIGN(__PAGE_SIZE__ * __TSTACK_PAGES__);
	_bsp_stack_start = .; 
	bsp_stack = .;
	. += (__PAGE_SIZE__ * __TSTACK_PAGES__);
	_bsp_stack_end = .;

	. = ALIGN(__PAGE_SIZE__ * __ISTACK_PAGES__);
	_intr_stack_start = .; 
	intr_stack = .;
	. += (__PAGE_SIZE__ * __ISTACK_PAGES__);
	_intr_stack_end = .;

        *(.bss)
	*(COMMON)
        __bss_end = .;
    }
    . = ALIGN(__PAGE_SIZE__);
    _edata = .;			/* End of data section */
    . = ALIGN(__PAGE_SIZE__);
    _payload_start = .;
    .payload : { *(.payload) }
    _payload_end = .;
    . = ALIGN(__PAGE_SIZE__);
    _end = .  - __KERN_VMA_BASE;
    _kernel_end = . - __KERN_VMA_BASE;
    _kheap_start = .;
    . += (__KHEAP_SIZE__);
    _kheap_end = .;

    /DISCARD/ :
    {
	         *(.gcc_except_table)
                 *(.eh_frame)
                 *(.note)
                 *(.comment)
                 *(.rel.*)
                 *(.rela.*)
    }
}

