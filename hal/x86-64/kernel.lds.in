/* ld script to make 32bit boot loader
 * This is derived from Martin Mares's ld script for i386 Linux kernel.
 * Copyright Takeharu KATO 2000 
 */
OUTPUT_FORMAT("elf64-x86-64", "elf64-x86-64", "elf64-x86-64")
OUTPUT_ARCH(i386:x86-64)
KERN_VMA_BASE = 0xFFFF800000000000;
KERN_BASE = 0x100000;

ENTRY(start)
SECTIONS
{
    . = KERN_BASE;
    _kernel_start = .;
    .boot : {
        *(.boot_text)
        *(.boot_data)
	. = ALIGN(__PAGE_SIZE__ * __KSTACK_PAGES__);
	_bsp_stack_start = .;
	bsp_stack = .;
	. += (__PAGE_SIZE__ * __KSTACK_PAGES__);
	_bsp_stack_end = .;
    }

    . += KERN_VMA_BASE;
    .text : AT(ADDR(.text) - KERN_VMA_BASE) {
        *(.text .rela.text .stub .text.* .gnu.linkonce.t.*)
        _rodata_start = .;
        *(.rodata .rodata.* .gnu.linkonce.r.*)
        _rodata_end = .;
    }

    .data : AT(ADDR(.data) - KERN_VMA_BASE) {
        _data_start = .;
        *(.data)
        _data_end = .;
    }

    . = ALIGN(0x1000);
    .bss :  AT(ADDR(.bss) - KERN_VMA_BASE) {
        _phys_bss_start = ( . - KERN_VMA_BASE );
        *(.bss)
	*(COMMON)
        _phys_bss_end = ( . - KERN_VMA_BASE );
    }
    . = ALIGN(0x1000);
    _edata = .;			/* End of data section */
    . = ALIGN(__PAGE_SIZE__);
    _payload_start = .;
    .payload : { *(.payload) }
    _payload_end = .;
    . = ALIGN(__PAGE_SIZE__);
    _end = .  - KERN_VMA_BASE;
    _kernel_end = . - KERN_VMA_BASE;
    _kheap_start = .;
    . += (__KHEAP_SIZE__);
    _kheap_end = .;

    /DISCARD/ :
    {
	         *(.gcc_except_table)
                 *(.eh_frame)
                 *(.note)
                 *(.comment)
                 *(.rel.*)
                 *(.rela.*)
    }
}

